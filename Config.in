## package/kernix-calibrate/Config.in
```kconfig
config BR2_PACKAGE_KERNIX_CALIBRATE
	bool "kernix-calibrate"
	select BR2_PACKAGE_SQLITE
	select BR2_PACKAGE_MPG123
	help
	  Framebuffer RGB and raw touchscreen calibration diagnostic.
```
